## drivers/staging/rk29/ipp/Kconfig
```kconfig
menu "IPP"
config RK29_IPP
	tristate "ROCKCHIP RK29 IPP"
	default m
	help
          rk29 ipp module.	
          
config DEINTERLACE
	bool "Deinterlacing support"
	depends on 	RK29_IPP	
	default y
	help 
          Mobile phone does not support deinterlacing
	
endmenu
```
